#include "kblunix.dtsi" // The shared dtsi file is included in the overlay

&default_transform { // Offset of 6 because the left side has 6 columns
    col-offset = <6>;
};


// Label of the kscan node in the dtsi
&kscan0 {

    row-gpios = 
        /*
        = <&pro_micro 017 (GPIO_ACTIVE_HIGH | GPIO_PULL_DOWN)>
        , <&pro_micro 020 (GPIO_ACTIVE_HIGH | GPIO_PULL_DOWN)>
        , <&pro_micro 106 (GPIO_ACTIVE_HIGH | GPIO_PULL_DOWN)>
        , <&pro_micro 029 (GPIO_ACTIVE_HIGH | GPIO_PULL_DOWN)>
        , <&pro_micro 031 (GPIO_ACTIVE_HIGH | GPIO_PULL_DOWN)>
        */
          <&pro_micro  2 (GPIO_ACTIVE_HIGH | GPIO_PULL_DOWN)>
        , <&pro_micro  3 (GPIO_ACTIVE_HIGH | GPIO_PULL_DOWN)>
        , <&pro_micro  9 (GPIO_ACTIVE_HIGH | GPIO_PULL_DOWN)>
        , <&pro_micro 20 (GPIO_ACTIVE_HIGH | GPIO_PULL_DOWN)>
        , <&pro_micro 21 (GPIO_ACTIVE_HIGH | GPIO_PULL_DOWN)>
        ;
        


    col-gpios = 
        /*
        = <&pro_micro 002 GPIO_ACTIVE_HIGH>
        , <&pro_micro 115 GPIO_ACTIVE_HIGH>
        , <&pro_micro 113 GPIO_ACTIVE_HIGH>
        , <&pro_micro 010 GPIO_ACTIVE_HIGH>
        , <&pro_micro 009 GPIO_ACTIVE_HIGH>
        , <&pro_micro 100 GPIO_ACTIVE_HIGH>
        , <&pro_micro 024 GPIO_ACTIVE_HIGH>
        , <&pro_micro 022 GPIO_ACTIVE_HIGH>
        */
          <&pro_micro 19 GPIO_ACTIVE_HIGH>
        , <&pro_micro 18 GPIO_ACTIVE_HIGH>
        , <&pro_micro 15 GPIO_ACTIVE_HIGH>
        , <&pro_micro 16 GPIO_ACTIVE_HIGH>
        , <&pro_micro  5 GPIO_ACTIVE_HIGH>
        , <&pro_micro  4 GPIO_ACTIVE_HIGH>
        ;
};